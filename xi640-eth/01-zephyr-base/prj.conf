## CMakeLists.txt
```
# SPDX-License-Identifier: Apache-2.0
# Xi 640 ETH - Minimal Boot Test

cmake_minimum_required(VERSION 3.20.0)

find_package(Zephyr REQUIRED HINTS $ENV{ZEPHYR_BASE})
project(xi640_eth_minimal VERSION 0.1.0)

# Application sources - minimal test only
target_sources(app PRIVATE
    src/main.c
)

# Temporarily disabled for minimal test
# target_sources(app PRIVATE src/thermal_frame_generator.c)
# target_include_directories(app PRIVATE ${CMAKE_CURRENT_SOURCE_DIR}/src)
# target_include_directories(app PRIVATE ${CMAKE_CURRENT_SOURCE_DIR}/modules/thermal_simd)
# add_subdirectory(modules/thermal_simd)
# target_link_libraries(app PRIVATE thermal_simd)

# ========================================
# ARM Helium MVE Support via Compiler Flags
# (Zephyr Kconfig does not have CONFIG_ARM_MVE_FP)
# ========================================
target_compile_options(app PRIVATE
    -march=armv8.1-m.main+mve.fp+fp.dp
    -mfpu=auto
    -mfloat-abi=hard
)

# Optimization flags for maximum performance
target_compile_options(app PRIVATE
    -O3
    -ffast-math
    -funroll-loops
    -ftree-vectorize
)
```

## Kconfig
```
# Xi 640 ETH Thermal Camera Configuration

mainmenu "Xi 640 ETH Thermal Camera"

config THERMAL_HPIX
    int "Thermal sensor horizontal resolution"
    default 640
    help
      Horizontal pixel count for thermal sensor

config THERMAL_VPIX
    int "Thermal sensor vertical resolution"
    default 480
    help
      Vertical pixel count for thermal sensor

config THERMAL_BIT_DEPTH
    int "Thermal sensor ADC bit depth"
    default 14
    range 12 16
    help
      ADC resolution in bits (12, 14, or 16-bit)

config THERMAL_FRAME_RATE
    int "Target frame rate (Hz)"
    default 50
    help
      Simulated thermal sensor frame rate (VSYNC frequency)
      Will be increased to 125-160 FPS in later sessions

config THERMAL_FRAME_POOL_COUNT
    int "Number of frame buffers"
    default 3
    range 2 5
    help
      Triple buffering (current + processing + display)

config THERMAL_CALIBRATION_ENABLE
    bool "Enable calibration data storage"
    default y
    help
      Store dark frame, gain, and offset calibration in HyperFlash

config THERMAL_SYNTHETIC_MODE
    bool "Use synthetic frame generator (no physical camera)"
    default y
    help
      Generate test patterns instead of reading from DCMIPP
      Useful for development without hardware

choice THERMAL_TEST_PATTERN
    prompt "Synthetic test pattern"
    default THERMAL_PATTERN_GRADIENT
    depends on THERMAL_SYNTHETIC_MODE

config THERMAL_PATTERN_GRADIENT
    bool "Linear gradient (cold to hot)"

config THERMAL_PATTERN_HOTSPOT
    bool "Central hot spot with decay"

config THERMAL_PATTERN_CHECKERBOARD
    bool "Checkerboard thermal pattern"

config THERMAL_PATTERN_NOISE
    bool "Random thermal noise"

endchoice

config THERMAL_HOTSPOT_COUNT
    int "Number of hot spots in pattern"
    default 3
    range 1 10
    depends on THERMAL_PATTERN_HOTSPOT

source "Kconfig.zephyr"
```

## west.yml
```
# West manifest for Xi 640 ETH Thermal Camera
# Zephyr main branch (includes STM32N6570-DK support)
manifest:
  version: "0.13"

  defaults:
    remote: zephyrproject-rtos

  remotes:
    - name: zephyrproject-rtos
      url-base: https://github.com/zephyrproject-rtos

  projects:
    - name: zephyr
      remote: zephyrproject-rtos
      revision: main
      import: true

  self:
    path: xi640-base
```

## prj.conf
```kconfig
# Xi 640 ETH - Minimal Boot Test Configuration
# Based on proven hello_world approach

# ========================================
# CONSOLE & UART (from working hello_world)
# ========================================
CONFIG_PRINTK=y
CONFIG_CONSOLE=y
CONFIG_SERIAL=y
CONFIG_UART_CONSOLE=y
CONFIG_STDOUT_CONSOLE=y
CONFIG_LOG=y
CONFIG_LOG_MODE_DEFERRED=n
CONFIG_EARLY_CONSOLE=y

# ========================================
# STACK SIZES - INCREASED TO FIX 27 KB OVERFLOW
# ========================================
CONFIG_MAIN_STACK_SIZE=32768
CONFIG_IDLE_STACK_SIZE=4096
CONFIG_ISR_STACK_SIZE=8192
CONFIG_SYSTEM_WORKQUEUE_STACK_SIZE=4096

# ========================================
# HEAP for k_malloc() (reduced for minimal test)
# ========================================
CONFIG_HEAP_MEM_POOL_SIZE=131072

# ========================================
# TIMING
# ========================================
CONFIG_TIMING_FUNCTIONS=y

# ========================================
# FPU SUPPORT
# ========================================
CONFIG_FPU=y
CONFIG_FPU_SHARING=y

# ========================================
# EXTERNAL MEMORY (PSRAM)
# ========================================
CONFIG_STM32_MEMMAP=y
CONFIG_MULTI_HEAP=y
CONFIG_MEM_ATTR=y
CONFIG_MEM_ATTR_HEAP=y

# ========================================
# HARDWARE
# ========================================
CONFIG_GPIO=y
CONFIG_FLASH=y
CONFIG_HW_STACK_PROTECTION=y
CONFIG_ARM_MPU=y
CONFIG_DYNAMIC_INTERRUPTS=y

# ========================================
# OPTIMIZATION
# ========================================
CONFIG_SPEED_OPTIMIZATIONS=y

# ========================================
# DEBUG
# ========================================
CONFIG_STACK_SENTINEL=y
CONFIG_THREAD_STACK_INFO=y

# Disable features to reduce RAM usage
CONFIG_THREAD_MONITOR=n
CONFIG_THREAD_NAME=n
```

## prj_native.conf
```kconfig
# Native POSIX/Linux simulation configuration
# Build with: west build -b native_sim

# Inherit base configuration
CONFIG_MAIN_STACK_SIZE=8192
CONFIG_HEAP_MEM_POOL_SIZE=65536

# Logging
CONFIG_LOG=y
CONFIG_LOG_MODE_IMMEDIATE=y
CONFIG_CONSOLE=y
CONFIG_PRINTK=y
CONFIG_SERIAL=y
CONFIG_UART_CONSOLE=y

# Timer
CONFIG_TIMER=y

# Thermal camera config
CONFIG_THERMAL_HPIX=640
CONFIG_THERMAL_VPIX=480
CONFIG_THERMAL_BIT_DEPTH=14
CONFIG_THERMAL_FRAME_RATE=50
CONFIG_THERMAL_FRAME_POOL_COUNT=3
CONFIG_THERMAL_SYNTHETIC_MODE=y
CONFIG_THERMAL_PATTERN_GRADIENT=y

# Performance
CONFIG_SPEED_OPTIMIZATIONS=y
CONFIG_FPU=y

# Thread monitoring
CONFIG_THREAD_MONITOR=y
CONFIG_THREAD_NAME=y
CONFIG_STATS=y

# Native sim specific
CONFIG_NATIVE_APPLICATION=y
```

## boards/stm32n6570_dk.overlay
```dts
/*
 * Device tree overlay for Xi 640 ETH thermal camera
 * HyperRAM external memory configuration for STM32N6570-DK
 *
 * Defines zephyr,extram chosen node for __extram attribute support
 */

/ {
	chosen {
		zephyr,extram = &hyperram;
	};

	soc {
		/* HyperRAM - 8 MB external PSRAM via XSPI @ 0x90000000 */
		hyperram: memory@90000000 {
			compatible = "zephyr,memory-region", "mmio-sram";
			reg = <0x90000000 DT_SIZE_M(8)>;
			zephyr,memory-region = "EXTRAM";
			zephyr,memory-attr = <( DT_MEM_ARM_MPU_RAM )>;
		};
	};
};
```

## src/main.c
```c
/**
 * @file main.c
 * @brief Xi 640 ETH - Minimal Boot Test
 *
 * Based on proven hello_world approach
 * Tests k_malloc() allocation to PSRAM before adding thermal processing
 */

#include <zephyr/kernel.h>

static void *frame_buffer = NULL;
static void *temp_frame_buffer = NULL;

int main(void)
{
    printk("\n\n========================================\n");
    printk("Xi 640 ETH - Minimal Boot Test\n");
    printk("========================================\n");
    printk("Build: %s %s\n", __DATE__, __TIME__);
    printk("\n");

    /* Allocate frame buffer (614 KB) */
    printk("Allocating frame_buffer (614 KB)...\n");
    frame_buffer = k_malloc(614400);
    if (!frame_buffer) {
        printk("ERROR: frame_buffer alloc failed\n");
        return -1;
    }
    printk("OK: frame_buffer = %p\n", frame_buffer);

    /* Allocate temp buffer (1228 KB) */
    printk("Allocating temp_frame_buffer (1228 KB)...\n");
    temp_frame_buffer = k_malloc(1228800);
    if (!temp_frame_buffer) {
        printk("ERROR: temp_frame_buffer alloc failed\n");
        k_free(frame_buffer);
        return -1;
    }
    printk("OK: temp_frame_buffer = %p\n", temp_frame_buffer);

    /* Check PSRAM placement */
    printk("\nMemory Check:\n");
    if ((uintptr_t)frame_buffer >= 0x90000000) {
        printk("  frame_buffer:      PSRAM (0x90000000+) OK!\n");
    } else {
        printk("  frame_buffer:      WARNING - NOT in PSRAM!\n");
    }

    if ((uintptr_t)temp_frame_buffer >= 0x90000000) {
        printk("  temp_frame_buffer: PSRAM (0x90000000+) OK!\n");
    } else {
        printk("  temp_frame_buffer: WARNING - NOT in PSRAM!\n");
    }

    printk("\n========================================\n");
    printk("ALL TESTS PASSED!\n");
    printk("========================================\n\n");

    /* Main loop - heartbeat every 2 seconds */
    int count = 0;
    while (1) {
        printk("[%d] System running...\n", count++);
        k_sleep(K_SECONDS(2));
    }

    return 0;
}
```

## src/memory_manager.c
```c
/**
 * @file memory_manager.c
 * @brief Memory manager implementation
 */

#include "memory_manager.h"
#include <zephyr/kernel.h>
#include <zephyr/sys/printk.h>
#include <zephyr/drivers/flash.h>
#include <string.h>

/* Memory region descriptors */
static memory_region_t regions[4] = {
    { .base_addr = (void *)AXISRAM1_BASE, .size = AXISRAM_SIZE, .used = 0, .name = "AXISRAM1" },
    { .base_addr = (void *)AXISRAM2_BASE, .size = AXISRAM_SIZE, .used = 0, .name = "AXISRAM2" },
    { .base_addr = (void *)AXISRAM3_BASE, .size = AXISRAM_SIZE, .used = 0, .name = "AXISRAM3" },
    { .base_addr = (void *)HYPERRAM_BASE, .size = HYPERRAM_SIZE, .used = 0, .name = "HYPERRAM" }
};

/* Frame pool (allocated from HyperRAM) */
static frame_pool_t frame_pool;

/* Mutex for frame pool access */
K_MUTEX_DEFINE(frame_pool_mutex);

/**
 * @brief Align value to specified alignment
 */
static inline uint32_t align_up(uint32_t value, uint32_t align)
{
    return (value + align - 1) & ~(align - 1);
}

/**
 * @brief Find frame index by pointer
 */
static int find_frame_index(thermal_frame_t *frame)
{
    for (int i = 0; i < FRAME_POOL_COUNT; i++) {
        if (frame_pool.frames[i] == frame) {
            return i;
        }
    }
    return -1;
}

/* ========================================
 * PUBLIC API IMPLEMENTATION
 * ======================================== */

int memory_manager_init(void)
{
    printk("Initializing memory manager...\n");

    /* Allocate frame pool from HyperRAM */
    for (int i = 0; i < FRAME_POOL_COUNT; i++) {
        frame_pool.frames[i] = (thermal_frame_t *)memory_allocate(3, sizeof(thermal_frame_t), 64);
        if (!frame_pool.frames[i]) {
            printk("ERROR: Failed to allocate frame %d\n", i);
            return -1;
        }
        frame_pool.locks[i] = false;
        memset(frame_pool.frames[i], 0, sizeof(thermal_frame_t));
    }

    frame_pool.current_capture_idx = 0;
    frame_pool.current_process_idx = 0;
    frame_pool.current_display_idx = 0;

    printk("Frame pool allocated: %d frames × %u bytes = %u KB\n",
           FRAME_POOL_COUNT, sizeof(thermal_frame_t),
           (FRAME_POOL_COUNT * sizeof(thermal_frame_t)) / 1024);

    memory_print_map();
    return 0;
}

void *memory_allocate(uint8_t region, uint32_t size, uint32_t align)
{
    if (region >= 4) return NULL;

    memory_region_t *reg = &regions[region];

    /* Align current position */
    uint32_t aligned_used = align_up(reg->used, align);

    /* Check if enough space */
    if (aligned_used + size > reg->size) {
        printk("ERROR: %s out of memory (need %u, have %u)\n",
               reg->name, size, reg->size - aligned_used);
        return NULL;
    }

    void *ptr = (uint8_t *)reg->base_addr + aligned_used;
    reg->used = aligned_used + size;

    return ptr;
}

frame_pool_t *memory_get_frame_pool(void)
{
    return &frame_pool;
}

thermal_frame_t *memory_acquire_capture_frame(void)
{
    k_mutex_lock(&frame_pool_mutex, K_FOREVER);

    /* Find next unlocked frame for capture */
    for (int i = 0; i < FRAME_POOL_COUNT; i++) {
        uint8_t idx = (frame_pool.current_capture_idx + i) % FRAME_POOL_COUNT;
        if (!frame_pool.locks[idx]) {
            frame_pool.locks[idx] = true;
            frame_pool.current_capture_idx = (idx + 1) % FRAME_POOL_COUNT;
            k_mutex_unlock(&frame_pool_mutex);
            return frame_pool.frames[idx];
        }
    }

    k_mutex_unlock(&frame_pool_mutex);
    return NULL; /* All frames locked */
}

thermal_frame_t *memory_acquire_process_frame(void)
{
    k_mutex_lock(&frame_pool_mutex, K_FOREVER);

    /* Get frame that was last captured */
    uint8_t idx = (frame_pool.current_capture_idx - 1 + FRAME_POOL_COUNT) % FRAME_POOL_COUNT;
    if (frame_pool.locks[idx]) {
        frame_pool.current_process_idx = idx;
        k_mutex_unlock(&frame_pool_mutex);
        return frame_pool.frames[idx];
    }

    k_mutex_unlock(&frame_pool_mutex);
    return NULL;
}

thermal_frame_t *memory_acquire_display_frame(void)
{
    k_mutex_lock(&frame_pool_mutex, K_FOREVER);

    /* Get frame that was last processed */
    uint8_t idx = frame_pool.current_process_idx;
    if (frame_pool.locks[idx]) {
        frame_pool.current_display_idx = idx;
        k_mutex_unlock(&frame_pool_mutex);
        return frame_pool.frames[idx];
    }

    k_mutex_unlock(&frame_pool_mutex);
    return NULL;
}

void memory_release_frame(thermal_frame_t *frame)
{
    k_mutex_lock(&frame_pool_mutex, K_FOREVER);

    int idx = find_frame_index(frame);
    if (idx >= 0) {
        frame_pool.locks[idx] = false;
    }

    k_mutex_unlock(&frame_pool_mutex);
}

void memory_get_stats(uint8_t region, uint32_t *used, uint32_t *total)
{
    if (region >= 4) return;

    if (used) *used = regions[region].used;
    if (total) *total = regions[region].size;
}

int memory_write_calibration(uint32_t offset, const void *data, uint32_t size)
{
    /* Direct memory-mapped write to HyperFlash */
    volatile uint8_t *flash_addr = (volatile uint8_t *)(HYPERFLASH_BASE + offset);

    /* TODO: In production, add sector erase + write verification */
    memcpy((void *)flash_addr, data, size);

    printk("Calibration data written: offset=0x%08X, size=%u bytes\n", offset, size);
    return 0;
}

int memory_read_calibration(uint32_t offset, void *data, uint32_t size)
{
    /* Direct memory-mapped read from HyperFlash */
    volatile uint8_t *flash_addr = (volatile uint8_t *)(HYPERFLASH_BASE + offset);

    memcpy(data, (void *)flash_addr, size);

    return 0;
}

void memory_print_map(void)
{
    printk("\n=== MEMORY MAP ===\n");
    printk("Region       Base        Size      Used      Free      Usage\n");
    printk("----------------------------------------------------------------\n");

    for (int i = 0; i < 4; i++) {
        memory_region_t *reg = &regions[i];
        uint32_t free = reg->size - reg->used;
        uint32_t usage_percent = (reg->used * 100) / reg->size;

        printk("%-12s 0x%08X  %7u  %7u  %7u  %3u%%\n",
               reg->name,
               (uint32_t)reg->base_addr,
               reg->size,
               reg->used,
               free,
               usage_percent);
    }

    printk("\nFrame Pool: %d frames × %u bytes (HyperRAM)\n",
           FRAME_POOL_COUNT, sizeof(thermal_frame_t));
    printk("  Capture idx: %d\n", frame_pool.current_capture_idx);
    printk("  Process idx: %d\n", frame_pool.current_process_idx);
    printk("  Display idx: %d\n", frame_pool.current_display_idx);
    printk("  Locks: [%d %d %d]\n",
           frame_pool.locks[0], frame_pool.locks[1], frame_pool.locks[2]);
    printk("================================================================\n\n");
}
```

## src/memory_manager.h
```c
/**
 * @file memory_manager.h
 * @brief Memory management for Xi 640 ETH thermal pipeline
 *
 * Manages memory allocation across:
 * - AXISRAM1 (1MB): DMA buffers for DCMIPP capture
 * - AXISRAM2 (1MB): Processing buffers (gain, dark frame, offset)
 * - AXISRAM3 (1MB): Bad pixel correction data
 * - HyperRAM (64MB): Frame pool for triple buffering
 * - HyperFlash (128MB): Calibration data persistence
 */

#ifndef MEMORY_MANAGER_H
#define MEMORY_MANAGER_H

#include <stdint.h>
#include <stdbool.h>
#include "thermal_frame_generator.h"

/* Memory region base addresses (from device tree) */
#define AXISRAM1_BASE  0x24000000  /* DMA buffers */
#define AXISRAM2_BASE  0x24100000  /* Processing */
#define AXISRAM3_BASE  0x24200000  /* Calibration */
#define HYPERRAM_BASE  0x90000000  /* Frame pool */
#define HYPERFLASH_BASE 0x70000000 /* Persistent storage */

/* Region sizes */
#define AXISRAM_SIZE   (1024 * 1024)  /* 1 MB each */
#define HYPERRAM_SIZE  (64 * 1024 * 1024)   /* 64 MB */
#define HYPERFLASH_SIZE (128 * 1024 * 1024) /* 128 MB */

/* Frame buffer constants */
#define FRAME_SIZE_BYTES (640 * 480 * 2)  /* 614,400 bytes per frame */
#define FRAME_POOL_COUNT 3                /* Triple buffering */

/* Memory pool structure */
typedef struct {
    void *base_addr;
    uint32_t size;
    uint32_t used;
    const char *name;
} memory_region_t;

/* Frame pool management */
typedef struct {
    thermal_frame_t *frames[FRAME_POOL_COUNT];
    uint8_t current_capture_idx;
    uint8_t current_process_idx;
    uint8_t current_display_idx;
    bool locks[FRAME_POOL_COUNT];
} frame_pool_t;

/**
 * @brief Initialize all memory regions
 * @return 0 on success, negative on error
 */
int memory_manager_init(void);

/**
 * @brief Allocate memory from specific region
 * @param region Region identifier (0=AXISRAM1, 1=AXISRAM2, 2=AXISRAM3, 3=HYPERRAM)
 * @param size Size in bytes
 * @param align Alignment requirement (must be power of 2)
 * @return Pointer to allocated memory, or NULL on failure
 */
void *memory_allocate(uint8_t region, uint32_t size, uint32_t align);

/**
 * @brief Get frame pool instance
 * @return Pointer to frame pool
 */
frame_pool_t *memory_get_frame_pool(void);

/**
 * @brief Acquire frame for capture (from DMA)
 * @return Pointer to frame, or NULL if none available
 */
thermal_frame_t *memory_acquire_capture_frame(void);

/**
 * @brief Acquire frame for processing
 * @return Pointer to frame, or NULL if none available
 */
thermal_frame_t *memory_acquire_process_frame(void);

/**
 * @brief Acquire frame for display/transmission
 * @return Pointer to frame, or NULL if none available
 */
thermal_frame_t *memory_acquire_display_frame(void);

/**
 * @brief Release frame back to pool
 * @param frame Frame to release
 */
void memory_release_frame(thermal_frame_t *frame);

/**
 * @brief Get memory usage statistics
 * @param region Region identifier
 * @param used Output: bytes used
 * @param total Output: total bytes
 */
void memory_get_stats(uint8_t region, uint32_t *used, uint32_t *total);

/**
 * @brief Write calibration data to HyperFlash
 * @param offset Offset in bytes from HyperFlash base
 * @param data Source data
 * @param size Data size in bytes
 * @return 0 on success, negative on error
 */
int memory_write_calibration(uint32_t offset, const void *data, uint32_t size);

/**
 * @brief Read calibration data from HyperFlash
 * @param offset Offset in bytes from HyperFlash base
 * @param data Destination buffer
 * @param size Data size in bytes
 * @return 0 on success, negative on error
 */
int memory_read_calibration(uint32_t offset, void *data, uint32_t size);

/**
 * @brief Print memory map and usage statistics
 */
void memory_print_map(void);

#endif /* MEMORY_MANAGER_H */
```

## src/thermal_frame_generator.c
```c
/**
 * @file thermal_frame_generator.c
 * @brief Synthetic thermal frame generator implementation
 */

#include "thermal_frame_generator.h"
#include <zephyr/kernel.h>
#include <zephyr/sys/printk.h>
#include <stdlib.h>
#include <math.h>

#define MAX_HOTSPOTS 10

/* Generator state */
static struct {
    thermal_pattern_type_t pattern;
    thermal_hotspot_t hotspots[MAX_HOTSPOTS];
    uint8_t hotspot_count;
    uint32_t frame_counter;
    uint16_t min_adc;
    uint16_t max_adc;
    uint32_t sum_adc;
} gen_state;

/**
 * @brief Fast square root approximation for hot spot decay calculation
 */
static inline uint16_t fast_distance(int16_t dx, int16_t dy)
{
    /* Manhattan distance approximation (faster than true Euclidean) */
    uint16_t abs_dx = abs(dx);
    uint16_t abs_dy = abs(dy);
    return abs_dx + abs_dy - (MIN(abs_dx, abs_dy) >> 1);
}

/**
 * @brief Generate gradient pattern (cold→hot)
 */
static void generate_gradient(thermal_frame_t *frame)
{
    for (int y = 0; y < THERMAL_HEIGHT; y++) {
        /* Linear gradient from 20% to 80% of ADC range */
        uint16_t line_value = THERMAL_ADC_MIN +
            ((THERMAL_ADC_MAX * 6 / 10) * y) / THERMAL_HEIGHT +
            (THERMAL_ADC_MAX * 2 / 10);

        for (int x = 0; x < THERMAL_WIDTH; x++) {
            frame->pixels[y * THERMAL_WIDTH + x] = line_value;
        }
    }
}

/**
 * @brief Generate hot spot pattern with radial decay
 */
static void generate_hotspot(thermal_frame_t *frame)
{
    /* Base temperature (ambient) */
    uint16_t ambient = THERMAL_ADC_MAX / 3;

    /* Fill with ambient first */
    for (int i = 0; i < THERMAL_PIXELS; i++) {
        frame->pixels[i] = ambient;
    }

    /* Apply each hot spot */
    for (uint8_t h = 0; h < gen_state.hotspot_count; h++) {
        thermal_hotspot_t *hs = &gen_state.hotspots[h];

        for (int y = 0; y < THERMAL_HEIGHT; y++) {
            for (int x = 0; x < THERMAL_WIDTH; x++) {
                int16_t dx = x - hs->x;
                int16_t dy = y - hs->y;
                uint16_t dist = fast_distance(dx, dy);

                if (dist < hs->radius) {
                    /* Radial decay: temp = peak * (1 - dist/radius)^2 */
                    uint32_t decay = hs->radius - dist;
                    uint32_t temp = ambient +
                        ((hs->temp_peak - ambient) * decay * decay) /
                        (hs->radius * hs->radius);

                    /* Accumulate (multiple hot spots can overlap) */
                    uint32_t current = frame->pixels[y * THERMAL_WIDTH + x];
                    frame->pixels[y * THERMAL_WIDTH + x] = MIN(current + temp - ambient,
                                                                THERMAL_ADC_MAX);
                }
            }
        }
    }
}

/**
 * @brief Generate checkerboard pattern
 */
static void generate_checkerboard(thermal_frame_t *frame)
{
    const uint16_t block_size = 40; /* 40×40 pixel blocks */
    const uint16_t cold_val = THERMAL_ADC_MAX / 4;
    const uint16_t hot_val = THERMAL_ADC_MAX * 3 / 4;

    for (int y = 0; y < THERMAL_HEIGHT; y++) {
        for (int x = 0; x < THERMAL_WIDTH; x++) {
            bool is_hot = ((x / block_size) + (y / block_size)) & 1;
            frame->pixels[y * THERMAL_WIDTH + x] = is_hot ? hot_val : cold_val;
        }
    }
}

/**
 * @brief Generate random thermal noise
 */
static void generate_noise(thermal_frame_t *frame)
{
    /* LFSR-based pseudo-random number generator (fast) */
    static uint32_t lfsr = 0xACE1u;

    for (int i = 0; i < THERMAL_PIXELS; i++) {
        /* Galois LFSR */
        lfsr = (lfsr >> 1) ^ (-(lfsr & 1u) & 0xD0000001u);

        /* Map to ADC range (30-70% for realistic thermal noise) */
        frame->pixels[i] = (THERMAL_ADC_MAX * 3 / 10) +
                          (lfsr % (THERMAL_ADC_MAX * 4 / 10));
    }
}

/**
 * @brief Generate moving hot spot (animated)
 */
static void generate_moving_hotspot(thermal_frame_t *frame)
{
    /* Circular motion */
    float angle = (gen_state.frame_counter * 0.05f);
    int16_t center_x = THERMAL_WIDTH / 2;
    int16_t center_y = THERMAL_HEIGHT / 2;
    int16_t radius = THERMAL_WIDTH / 4;

    thermal_hotspot_t moving_hs = {
        .x = center_x + (int16_t)(radius * cosf(angle)),
        .y = center_y + (int16_t)(radius * sinf(angle)),
        .temp_peak = THERMAL_ADC_MAX * 9 / 10,
        .radius = 80
    };

    /* Generate base ambient */
    uint16_t ambient = THERMAL_ADC_MAX / 3;
    for (int i = 0; i < THERMAL_PIXELS; i++) {
        frame->pixels[i] = ambient;
    }

    /* Apply moving hot spot */
    for (int y = 0; y < THERMAL_HEIGHT; y++) {
        for (int x = 0; x < THERMAL_WIDTH; x++) {
            int16_t dx = x - moving_hs.x;
            int16_t dy = y - moving_hs.y;
            uint16_t dist = fast_distance(dx, dy);

            if (dist < moving_hs.radius) {
                uint32_t decay = moving_hs.radius - dist;
                uint32_t temp = ambient +
                    ((moving_hs.temp_peak - ambient) * decay * decay) /
                    (moving_hs.radius * moving_hs.radius);

                frame->pixels[y * THERMAL_WIDTH + x] = MIN(temp, THERMAL_ADC_MAX);
            }
        }
    }
}

/**
 * @brief Calculate frame statistics
 */
static void calculate_stats(thermal_frame_t *frame)
{
    gen_state.min_adc = THERMAL_ADC_MAX;
    gen_state.max_adc = THERMAL_ADC_MIN;
    gen_state.sum_adc = 0;

    for (int i = 0; i < THERMAL_PIXELS; i++) {
        uint16_t val = frame->pixels[i];
        if (val < gen_state.min_adc) gen_state.min_adc = val;
        if (val > gen_state.max_adc) gen_state.max_adc = val;
        gen_state.sum_adc += val;
    }
}

/* ========================================
 * PUBLIC API IMPLEMENTATION
 * ======================================== */

int thermal_generator_init(thermal_pattern_type_t pattern)
{
    gen_state.pattern = pattern;
    gen_state.hotspot_count = 0;
    gen_state.frame_counter = 0;

    /* Add default hot spots for HOTSPOT pattern */
    if (pattern == PATTERN_HOTSPOT) {
        thermal_hotspot_t default_spots[] = {
            { .x = 320, .y = 240, .temp_peak = THERMAL_ADC_MAX * 9 / 10, .radius = 100 },
            { .x = 160, .y = 120, .temp_peak = THERMAL_ADC_MAX * 7 / 10, .radius = 60 },
            { .x = 480, .y = 360, .temp_peak = THERMAL_ADC_MAX * 8 / 10, .radius = 80 }
        };

        for (int i = 0; i < 3; i++) {
            thermal_generator_add_hotspot(&default_spots[i]);
        }
    }

    printk("Thermal frame generator initialized (pattern=%d)\n", pattern);
    return 0;
}

int thermal_generator_create_frame(thermal_frame_t *frame)
{
    if (!frame) return -1;

    /* Set metadata */
    frame->frame_number = gen_state.frame_counter++;
    frame->timestamp_us = k_uptime_get();

    /* Generate pattern */
    switch (gen_state.pattern) {
    case PATTERN_GRADIENT:
        generate_gradient(frame);
        break;
    case PATTERN_HOTSPOT:
        generate_hotspot(frame);
        break;
    case PATTERN_CHECKERBOARD:
        generate_checkerboard(frame);
        break;
    case PATTERN_NOISE:
        generate_noise(frame);
        break;
    case PATTERN_MOVING_HOTSPOT:
        generate_moving_hotspot(frame);
        break;
    default:
        generate_gradient(frame);
    }

    /* Calculate statistics */
    calculate_stats(frame);

    return 0;
}

void thermal_generator_set_pattern(thermal_pattern_type_t pattern)
{
    gen_state.pattern = pattern;
    printk("Pattern changed to %d\n", pattern);
}

int thermal_generator_add_hotspot(const thermal_hotspot_t *hotspot)
{
    if (gen_state.hotspot_count >= MAX_HOTSPOTS) {
        return -1;
    }

    gen_state.hotspots[gen_state.hotspot_count++] = *hotspot;
    return 0;
}

void thermal_generator_clear_hotspots(void)
{
    gen_state.hotspot_count = 0;
}

void thermal_generator_get_stats(uint16_t *min_val, uint16_t *max_val, uint32_t *avg_val)
{
    if (min_val) *min_val = gen_state.min_adc;
    if (max_val) *max_val = gen_state.max_adc;
    if (avg_val) *avg_val = gen_state.sum_adc / THERMAL_PIXELS;
}
```

## src/thermal_frame_generator.h
```c
/**
 * @file thermal_frame_generator.h
 * @brief Synthetic thermal frame generator for Xi 640 ETH development
 *
 * Generates test patterns when physical thermal sensor is not available:
 * - Linear gradients (cold to hot)
 * - Hot spot patterns with radial decay
 * - Checkerboard thermal patterns
 * - Random thermal noise
 *
 * Frame format: 640×480 @ 14-bit (0-16383 ADC values)
 */

#ifndef THERMAL_FRAME_GENERATOR_H
#define THERMAL_FRAME_GENERATOR_H

#include <stdint.h>
#include <stdbool.h>
#include "thermal_types.h"  /* Common thermal frame type definitions */

/* Frame dimensions */
#define THERMAL_WIDTH  640
#define THERMAL_HEIGHT 480
#define THERMAL_PIXELS (THERMAL_WIDTH * THERMAL_HEIGHT)

/* 14-bit ADC range */
#define THERMAL_ADC_MIN 0
#define THERMAL_ADC_MAX 16383

/* thermal_frame_t is defined in thermal_types.h */

/* Test pattern types */
typedef enum {
    PATTERN_GRADIENT,      /* Linear cold→hot gradient */
    PATTERN_HOTSPOT,       /* Central hot spot with decay */
    PATTERN_CHECKERBOARD,  /* Checkerboard pattern */
    PATTERN_NOISE,         /* Random thermal noise */
    PATTERN_MOVING_HOTSPOT /* Animated hot spot */
} thermal_pattern_type_t;

/* Hot spot configuration */
typedef struct {
    int16_t x;           /* Center X coordinate */
    int16_t y;           /* Center Y coordinate */
    uint16_t temp_peak;  /* Peak temperature (ADC value) */
    uint16_t radius;     /* Decay radius in pixels */
} thermal_hotspot_t;

/**
 * @brief Initialize thermal frame generator
 * @param pattern Initial test pattern type
 * @return 0 on success, negative on error
 */
int thermal_generator_init(thermal_pattern_type_t pattern);

/**
 * @brief Generate synthetic thermal frame
 * @param frame Output buffer (must be pre-allocated)
 * @return 0 on success, negative on error
 */
int thermal_generator_create_frame(thermal_frame_t *frame);

/**
 * @brief Set test pattern type
 * @param pattern New pattern type
 */
void thermal_generator_set_pattern(thermal_pattern_type_t pattern);

/**
 * @brief Add hot spot to current pattern
 * @param hotspot Hot spot configuration
 * @return 0 on success, negative if max hot spots reached
 */
int thermal_generator_add_hotspot(const thermal_hotspot_t *hotspot);

/**
 * @brief Clear all hot spots
 */
void thermal_generator_clear_hotspots(void);

/**
 * @brief Get current frame statistics
 * @param min_val Output: minimum ADC value in last frame
 * @param max_val Output: maximum ADC value in last frame
 * @param avg_val Output: average ADC value in last frame
 */
void thermal_generator_get_stats(uint16_t *min_val, uint16_t *max_val, uint32_t *avg_val);

#endif /* THERMAL_FRAME_GENERATOR_H */
```

## src/thermal_types.h
```c
/**
 * @file thermal_types.h
 * @brief Common thermal frame type definitions for Xi 640 ETH
 *
 * Shared between thermal_frame_generator and thermal_simd modules
 * to avoid type conflicts.
 */

#ifndef THERMAL_TYPES_H
#define THERMAL_TYPES_H

#include <stdint.h>

/* Xi 640 ETH sensor specifications */
#define FRAME_WIDTH  640
#define FRAME_HEIGHT 480
#define FRAME_PIXELS (FRAME_WIDTH * FRAME_HEIGHT)

/**
 * @brief Raw thermal frame from sensor (14-bit ADC values)
 *
 * Single definition used by both frame generator and thermal SIMD modules
 */
typedef struct {
    uint16_t pixels[FRAME_PIXELS];  // Flattened array for efficient processing
    uint32_t frame_number;          // Frame sequence number (also used as frame_id)
    uint64_t timestamp_us;          // Timestamp in microseconds (also used as timestamp)
} thermal_frame_t;

/**
 * @brief Processed temperature frame (Celsius * 100)
 *
 * Output from thermal SIMD processing pipeline
 */
typedef struct {
    int16_t temps[FRAME_PIXELS];  // Temperature in 0.01°C units (Celsius * 100)
    uint32_t frame_id;            // Frame sequence number
    uint64_t timestamp;           // Timestamp
    float min_temp;               // Minimum temperature in frame
    float max_temp;               // Maximum temperature in frame
    float avg_temp;               // Average temperature in frame
} temperature_frame_t;

#endif /* THERMAL_TYPES_H */
```
